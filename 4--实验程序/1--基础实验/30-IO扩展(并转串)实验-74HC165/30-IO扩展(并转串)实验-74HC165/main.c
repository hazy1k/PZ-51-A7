/**************************************************************************************
深圳市普中科技有限公司（PRECHIN 普中）
技术支持：www.prechin.net
PRECHIN
 普中
 
实验名称：IO扩展(并转串)实验-74HC165
接线说明：	
实验现象：下载程序后，独立按键模块的K1-K8键按下控制对应LED模块D1-D8指示灯
注意事项：																				  
***************************************************************************************/
#include "reg52.h"

typedef unsigned int u16;	//对系统默认数据类型进行重定义
typedef unsigned char u8;

//定义74HC165控制管脚
sbit HC165_QH=P1^7;	//串行数据输出
sbit HC165_CLK=P1^6;//时钟输入
sbit HC165_SHLD=P1^5;//寄存器存储控制

#define LED_PORT	P2	//LED模块控制


/*******************************************************************************
* 函 数 名       : delay_10us
* 函数功能		 : 延时函数，ten_us=1时，大约延时10us
* 输    入       : ten_us
* 输    出    	 : 无
*******************************************************************************/
void delay_10us(u16 ten_us)
{
	while(ten_us--);	
}

/*******************************************************************************
* 函 数 名       : delay_ms
* 函数功能		 : ms延时函数，ms=1时，大约延时1ms
* 输    入       : ten_us
* 输    出    	 : 无
*******************************************************************************/
void delay_ms(u16 ms)
{
	u16 i,j;
	for(i=ms;i>0;i--)
		for(j=110;j>0;j--);
}

/*******************************************************************************
* 函 数 名         : hc165_read_data(u8 dat)
* 函数功能		   : 从74HC165中读取一个字节数据
* 输    入         : 无
* 输    出         : 一个字节数据
*******************************************************************************/
u8 hc165_read_data(void)
{
	u8 i=0;
	u8 value=0;

	HC165_SHLD=0;//SHLD拉低，165并口数据传入到移位寄存器中
	delay_10us(5);//短暂延时
	HC165_SHLD=1;//SHLD拉高，禁止165并口数据传入到移位寄存器中

	for(i=0;i<8;i++)//循环8次读取一个字节
	{
		value<<=1;//左移1位，先读取的数据是高位，经过8次循环则将第一次读取的位放到字节高位
		HC165_CLK=0;//CLK INH为低电平开始读取数据
		delay_10us(5);
		value|=HC165_QH;
		HC165_CLK=1;//上升沿读取数据
		delay_10us(5);				
	}	
	return value;	
}


/*******************************************************************************
* 函 数 名       : main
* 函数功能		 : 主函数
* 输    入       : 无
* 输    出    	 : 无
*******************************************************************************/
void main()
{	
	u8 value=0;

	LED_PORT=0xff;//保证LED默认是熄灭的
	while(1)
	{		
		value=hc165_read_data();
		if(value!=0xff)LED_PORT=value;								
	}		
}